## sdkconfig.defaults
```kconfig
CONFIG_BT_ENABLED=y
CONFIG_BT_BLUEDROID_ENABLED=y
CONFIG_BT_BLE_ENABLED=y
CONFIG_BT_BLE_42_FEATURES_SUPPORTED=y
CONFIG_BT_BLE_SMP_BOND_NVS_FLASH=y
CONFIG_BT_SMP_MAX_BONDS=16
CONFIG_PARTITION_TABLE_SINGLE_APP_LARGE=y
```
